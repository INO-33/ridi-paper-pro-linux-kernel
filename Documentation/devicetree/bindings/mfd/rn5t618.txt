## Documentation/devicetree/bindings/mfd/rn5t618.txt
```
* Ricoh RN5T567/RN5T618/RC5T619 PMIC

Ricoh RN5T567/RN5T618 is a power management IC family which integrates
3 to 4 step-down DCDC converters, 7 low-dropout regulators, GPIOs and
a watchdog timer. The RN5T618 provides additionally a Li-ion battery
charger, fuel gauge and an ADC. It can be controlled through an I2C
interface.

Required properties:
 - compatible: must be one of
		"ricoh,rn5t567"
		"ricoh,rn5t618"
		"ricoh,rc5t619"
 - reg: the I2C slave address of the device

Optional properties:
 - interrupt-parent, interrupts: physical PMIC interrupt line.
 - wakeup-source: PMIC interrupt may wake the suspended system.
 - ricoh,charger-wakeup: E70Q10 RC5T619 opt-in to the shared PMIC IRQ
   domain (requires interrupts). Charger, VBAT-low ADC and RTC alarm are
   separate nested consumers. Charger debounce/quarantine only masks its
   own group and cannot mask the low-voltage/RTC wake paths. Unused master
   groups remain masked. Physical IRQ ownership belongs to the MFD only.
 - ricoh,ridi-stock-battery: select the recovered E70Q10 profile/SOC logic
   and stock 3550mV VBAT warning comparator. Requires charger-wakeup for
   suspend low-voltage wake. This does not change PMIC hard power-cut limits.

Sub-nodes:
 - regulators: the node is required if the regulator functionality is
   needed. The valid regulator names are: DCDC1, DCDC2, DCDC3, DCDC4
   (RN5T567), DCDC5 (RC5T619), LDO1, LDO2, LDO3, LDO4, LDO5,
   LDO6 through LDO10 (RC5T619), LDORTC1 and LDORTC2.
   The common bindings for each individual regulator can be found in:
   Documentation/devicetree/bindings/regulator/regulator.txt

Example:

	pmic@32 {
		compatible = "ricoh,rn5t618";
		reg = <0x32>;

		regulators {
			DCDC1 {
				regulator-min-microvolt = <1050000>;
				regulator-max-microvolt = <1050000>;
			};

			DCDC2 {
				regulator-min-microvolt = <1175000>;
				regulator-max-microvolt = <1175000>;
			};
		};
	};
```
